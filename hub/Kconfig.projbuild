## node/Kconfig.projbuild
```kconfig
menu "Inputs"

    menuconfig FACTORY_RESET_BUTTON_ENABLED
        bool "Factory reset button"
        default n
        help
            Enable factory reset via button held at boot.

    config FACTORY_RESET_BUTTON_GPIO
        int "Factory reset button GPIO"
        default 9
        depends on FACTORY_RESET_BUTTON_ENABLED
        help
            GPIO for factory reset button (active low).
            Default 9 is the BOOT button on ESP32-H2-DevKitM.

    menuconfig DHT_ENABLED
        bool "DHT Temperature/Humidity sensor"
        default n
        help
            Enable DHT temperature and humidity sensor.

    choice DHT_TYPE
        prompt "DHT sensor type"
        depends on DHT_ENABLED
        default DHT_TYPE_DHT11

        config DHT_TYPE_DHT11
            bool "DHT11"
            help
                DHT11 sensor (0-50°C, 1°C resolution)

        config DHT_TYPE_DHT22
            bool "DHT22/AM2301"
            help
                DHT22/AM2301 sensor (-40-80°C, 0.1°C resolution)
    endchoice

    config DHT_GPIO
        int "DHT data GPIO"
        default 4
        depends on DHT_ENABLED
        help
            GPIO for the DHT data pin.

endmenu

menu "Outputs"

    menuconfig STATUS_LED_ENABLED
        bool "Status LED strip"
        default n
        help
            Enable RGB LED strip (WS2812) to show activity status.

    config STATUS_LED_GPIO
        int "Status LED GPIO"
        default 8
        depends on STATUS_LED_ENABLED
        help
            GPIO for the RGB LED (WS2812).

    menuconfig RELAY_ENABLED
        bool "Relay"
        default n
        help
            Enable relay control output.

    config RELAY_GPIO
        int "Relay GPIO"
        default 0
        depends on RELAY_ENABLED
        help
            GPIO for the relay control signal.

endmenu
```

## sdkconfig.defaults
```kconfig
# Common configuration for all projects

# Flash size (detect 4MB chips correctly)
CONFIG_ESPTOOLPY_FLASHSIZE_4MB=y

# FreeRTOS
CONFIG_FREERTOS_GENERATE_RUN_TIME_STATS=y
CONFIG_FREERTOS_USE_TRACE_FACILITY=y
CONFIG_FREERTOS_USE_TICKLESS_IDLE=y

# Power management
CONFIG_PM_ENABLE=y
CONFIG_PM_DFS_INIT_AUTO=y
CONFIG_PM_PROFILING=y

# Thread/OpenThread
CONFIG_IEEE802154_ENABLED=y
CONFIG_IEEE802154_SLEEP_ENABLE=y
CONFIG_OPENTHREAD_ENABLED=y
CONFIG_OPENTHREAD_RADIO_NATIVE=y
CONFIG_OPENTHREAD_LOG_LEVEL_NOTE=y

# Required for OpenThread
CONFIG_LWIP_IPV6=y
CONFIG_ESP_NETIF_TCPIP_LWIP=y
```

## sdkconfig.defaults.thread
```kconfig
# Thread base configuration (no BLE)

# Disable Bluetooth
CONFIG_BT_ENABLED=n

# Enable IEEE 802.15.4 radio
CONFIG_IEEE802154_ENABLED=y

# Enable OpenThread
CONFIG_OPENTHREAD_ENABLED=y
CONFIG_OPENTHREAD_RADIO_NATIVE=y

# OpenThread logging
CONFIG_OPENTHREAD_LOG_LEVEL_NOTE=y

# Required for OpenThread
CONFIG_LWIP_IPV6=y
CONFIG_ESP_NETIF_TCPIP_LWIP=y
```

## thread-rcp/Kconfig.projbuild
```kconfig
menu "Thread RCP"

    config OPENTHREAD_UART_PIN_MANUAL
        bool "Configure RCP UART pin manually"
        default n
        help
            Select this to choose UART pin manually

    config OPENTHREAD_UART_RX_PIN
        int "UART RX pin"
        depends on OPENTHREAD_UART_PIN_MANUAL
        default 4
        range 0 27

    config OPENTHREAD_UART_TX_PIN
        int "UART TX pin"
        depends on OPENTHREAD_UART_PIN_MANUAL
        default 5
        range 0 27

endmenu
```

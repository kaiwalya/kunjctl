## thread-end-device/Kconfig.projbuild
```kconfig
menu "Thread End Device"

    config JOIN_TIMEOUT_MS
        int "Network join timeout (ms)"
        default 10000
        help
            Time to wait for joining a Thread network before entering deep sleep.
            Set to 0 to disable (never deep sleep).

    config MAIN_LOOP_INTERVAL_MS
        int "Main loop interval (ms)"
        default 10000
        help
            How often to run the main loop (read sensors, send reports, poll for commands).
            This also sets the SED poll period - radio wakes once per interval.

endmenu

menu "Inputs"

    menuconfig FACTORY_RESET_BUTTON_ENABLED
        bool "Factory reset button"
        default n
        help
            Enable factory reset via button press.
            Erases NVS (clears Thread network credentials) and restarts.

    config FACTORY_RESET_BUTTON_GPIO
        int "Factory reset button GPIO"
        default 9
        depends on FACTORY_RESET_BUTTON_ENABLED
        help
            GPIO for factory reset button (active low).
            Default 9 is the BOOT button on ESP32-H2-DevKitM.

    menuconfig DHT_ENABLED
        bool "DHT Temperature/Humidity sensor"
        default n
        help
            Enable DHT temperature and humidity sensor.

    choice DHT_TYPE
        prompt "DHT sensor type"
        depends on DHT_ENABLED
        default DHT_TYPE_DHT11

        config DHT_TYPE_DHT11
            bool "DHT11"
            help
                DHT11 sensor (0-50°C, 1°C resolution)

        config DHT_TYPE_DHT22
            bool "DHT22/AM2301"
            help
                DHT22/AM2301 sensor (-40-80°C, 0.1°C resolution)
    endchoice

    config DHT_GPIO
        int "DHT data GPIO"
        default 4
        depends on DHT_ENABLED
        help
            GPIO for the DHT data pin.

endmenu

menu "Outputs"

    menuconfig STATUS_LED_ENABLED
        bool "Status LED strip"
        default n
        help
            Enable RGB LED strip (WS2812) to show activity status.

    config STATUS_LED_GPIO
        int "Status LED GPIO"
        default 8
        depends on STATUS_LED_ENABLED
        help
            GPIO for the RGB LED (WS2812).

    menuconfig RELAY_ENABLED
        bool "Relay"
        default n
        help
            Enable relay control output.

    choice RELAY_TYPE
        prompt "Relay type"
        depends on RELAY_ENABLED
        default RELAY_TYPE_LEVEL

        config RELAY_TYPE_LEVEL
            bool "Level-driven (single coil, GPIO holds state)"
            help
                Standard relay held energized by a single GPIO. The pin is
                driven high for ON, low for OFF, and held across deep sleep
                via gpio_hold_en. Cuts power to the coil = relay opens.

        config RELAY_TYPE_LATCHING
            bool "Latching (dual coil, pulsed)"
            help
                Bistable relay with separate SET and RESET coils. A short
                pulse on SET turns it ON; a short pulse on RESET turns it
                OFF. Holds its state mechanically with no power. Both pins
                must never be driven high simultaneously.
    endchoice

    config RELAY_GPIO
        int "Relay GPIO"
        default 0
        depends on RELAY_ENABLED && RELAY_TYPE_LEVEL
        help
            GPIO for the relay control signal.

    config RELAY_SET_GPIO
        int "Relay SET coil GPIO"
        default 0
        depends on RELAY_ENABLED && RELAY_TYPE_LATCHING
        help
            GPIO that pulses the SET coil to turn the relay ON.

    config RELAY_RESET_GPIO
        int "Relay RESET coil GPIO"
        default 1
        depends on RELAY_ENABLED && RELAY_TYPE_LATCHING
        help
            GPIO that pulses the RESET coil to turn the relay OFF.
            Must be different from RELAY_SET_GPIO.

    config RELAY_PULSE_MS
        int "Latching coil pulse duration (ms)"
        default 20
        depends on RELAY_ENABLED && RELAY_TYPE_LATCHING
        help
            How long to energize a coil to flip the relay. Check your
            relay's datasheet for the minimum pulse width (typically
            10-50ms). Longer is safer but wears the coil faster.

endmenu
```
